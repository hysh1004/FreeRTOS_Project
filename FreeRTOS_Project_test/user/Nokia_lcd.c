
#include "Nokia_lcd.h"
#include "delay.h"
#include <string.h>
#include <stdio.h>
#include <stdint.h>

unsigned char font6x8[][6] =
{
    { 0x00, 0x00, 0x00, 0x00, 0x00, 0x00 },   // sp
    { 0x00, 0x00, 0x00, 0x2f, 0x00, 0x00 },   // !
    { 0x00, 0x00, 0x07, 0x00, 0x07, 0x00 },   // "
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    { 0x14, 0x14, 0x14, 0x14, 0x14, 0x14 }    // horiz lines
};
void Nokia_lcd_config(void){
	
	GPIO_InitTypeDef GPIO_InitStructure;
	
	RCC_AHB1PeriphClockCmd(RCC_AHB1Periph_GPIOA,ENABLE);	//时钟配置
	GPIO_InitStructure.GPIO_Pin = GPIO_Pin_0 | GPIO_Pin_1 | GPIO_Pin_2 | GPIO_Pin_3 | GPIO_Pin_4 | GPIO_Pin_5;//I\O口选择
	GPIO_InitStructure.GPIO_Mode = GPIO_Mode_OUT;	//输入输出模式
	GPIO_InitStructure.GPIO_OType = GPIO_OType_PP;	//输出方式
	GPIO_InitStructure.GPIO_PuPd = GPIO_PuPd_DOWN;	//上拉下拉
	GPIO_InitStructure.GPIO_Speed = GPIO_Speed_100MHz;	//引脚速度
	GPIO_Init(GPIOA,&GPIO_InitStructure);	//端口初始化
}

void Nokia_Init(void)
{
		BL_Flag(Bit_SET);
		Reset_Flag(Bit_RESET);
		delay_us(1);
		Reset_Flag(Bit_SET);
		delay_us(1);
	
		CE_Flag(Bit_RESET);
		delay_us(1);
		CE_Flag(Bit_SET);
		Nokia_send_byte(0x21,Bit_RESET);
		Nokia_send_byte(0x20,Bit_RESET);
		Nokia_clear();
		Nokia_send_byte(0x0C,Bit_RESET);
}
void Nokia_send_byte(uint8_t date,BitAction command)
{
		int i;
		CE_Flag(Bit_RESET);
		DC_Flag(command);		//写命令还是数据
		for(i=0;i<8;i++)
		{
				CLK_Flag(Bit_RESET);
				if(date&0x80)
						DIN_Flag(Bit_SET);
				else
						DIN_Flag(Bit_RESET);
				date = date << 1;
				CLK_Flag(Bit_SET);
		}
		CE_Flag(Bit_SET);
}
void Nokia_clear(void)
{
		int i;
		Nokia_send_byte(0x0C,Bit_RESET);
		Nokia_send_byte(0x80,Bit_RESET);
		for(i=0;i<504;i++)
				Nokia_send_byte(0,Bit_SET);
}
void Nokia_set_XY(uint8_t X,uint8_t Y)
{
		Nokia_send_byte(0X40|Y,Bit_RESET);
		Nokia_send_byte(0X80|X,Bit_RESET);
}
void Nokia_write_char(unsigned char c)
{
	unsigned char line;
	c -= 32;
	for (line=0; line<6; line++)
		Nokia_send_byte(font6x8[c][line],Bit_SET);
}
void Nokia_Date(uint8_t X,uint8_t Y,char *s)
{
		Nokia_set_XY(X,Y);
		while(*s)
		{
				Nokia_write_char(*s);
				s++;
		}
//		Nokia_send_byte(0x0D,Bit_RESET);//黑底白字
}
void Date_Send(uint8_t X,uint8_t Y,uint16_t date)
{
		char date_buff[DateSize] ={0};
		date_buff[0] = date/1000+48;
		date_buff[1] = date%1000/100+48;
		date_buff[2] = date%100/10+48;
		date_buff[3] = date%10+48;
		date_buff[4] = 'm';
		date_buff[5] = 'V';

		
		if(date_buff[0]=='0' && date_buff[1]=='0' && date_buff[2]=='0')
		{
				date_buff[0] = ' ';
				date_buff[1] = ' ';
				date_buff[2] = ' ';
		}
		if(date_buff[0]=='0' && date_buff[1]=='0')
		{
				date_buff[0] = ' ';
				date_buff[1] = ' ';
		}
		if(date_buff[0]=='0')
				date_buff[0] = ' ';
		Nokia_Date(X,Y,date_buff);
}
